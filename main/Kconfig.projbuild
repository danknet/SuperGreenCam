## main/Kconfig.projbuild
```kconfig
menu "SuperGreenOS Configuration"

config BROKER_URL
  string "Broker URL"
  default "mqtt://sink.supergreenlab.com:1883"
  help
    URL of the broker to connect to

config VERSION
  string "A name to give to this version"
  default SuperGreenDriver1.0
  help
    Version displayed in the logs

config OTA_SERVER_IP
  string "Over-The-Air server IP"
  default "142.93.167.50"
  help
    IP address of the server used for updates, will switch to DNS resolution ASAP:P

config OTA_SERVER_HOSTNAME
  string "Over-The-Air server hostname"
  default "update.supergreenlab.com"
  help
    DNS domain of the server used for updates, required in addition of the IP address, for http host header.

config OTA_SERVER_PORT
  string "Over-The-Air server port"
  default "80"
  help
    Port of the server used for updates.

config OTA_BASEDIR
  string "Over-The-Air base directory used to build urls"
  default "/SuperGreenOSBoilerplate"
  help
    Base directory used to build urls

config XCLK_FREQ
    int "XCLK Frequency"
    default "10000000"
    help
        The XCLK Frequency in Herz.
      
menu "Pin Configuration"
    config D0
        int "D0"
        default "5"
    config D1
        int "D1"
        default "18"
    config D2
        int "D2"
        default "19"
    config D3
        int "D3"
        default "21"
    config D4
        int "D4"
        default "36"
    config D5
        int "D5"
        default "39"
    config D6
        int "D6"
        default "34"
    config D7
        int "D7"
        default "35"
    config XCLK
        int "XCLK"
        default "0"
    config PCLK
        int "PCLK"
        default "22"
    config VSYNC
        int "VSYNC"
        default "25"
    config HREF
        int "HREF"
        default "23"
    config SDA
        int "SDA"
        default "26"
    config SCL
        int "SCL"
        default "27"
    config RESET
        int "RESET"
        default "32"
endmenu

endmenu
```
